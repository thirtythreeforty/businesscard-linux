## Config.in
```kconfig
source "$BR2_EXTERNAL_BUSINESSCARD_PATH/package/sunxi-tools-f1c100s/Config.in.host"
source "$BR2_EXTERNAL_BUSINESSCARD_PATH/package/sunxi-tools-f1c100s/Config.in"
source "$BR2_EXTERNAL_BUSINESSCARD_PATH/package/businesscard-flashdrive/Config.in"
source "$BR2_EXTERNAL_BUSINESSCARD_PATH/package/2048/Config.in"
source "$BR2_EXTERNAL_BUSINESSCARD_PATH/package/fortune-mod/Config.in"
source "$BR2_EXTERNAL_BUSINESSCARD_PATH/package/robotfindskitten/Config.in"
source "$BR2_EXTERNAL_BUSINESSCARD_PATH/package/rogue/Config.in"

source "$BR2_EXTERNAL_BUSINESSCARD_PATH/package/librecode/Config.in"
```

## board/businesscard/v1/linux_defconfig
```kconfig
# CONFIG_LOCALVERSION_AUTO is not set
# CONFIG_SWAP is not set
CONFIG_NO_HZ=y
CONFIG_HIGH_RES_TIMERS=y
CONFIG_CC_OPTIMIZE_FOR_SIZE=y
CONFIG_EXPERT=y
# CONFIG_MULTIUSER is not set
# CONFIG_SYSFS_SYSCALL is not set
# CONFIG_AIO is not set
# CONFIG_KALLSYMS is not set
CONFIG_PERF_EVENTS=y
# CONFIG_VM_EVENT_COUNTERS is not set
CONFIG_SLOB=y
# CONFIG_ARCH_MULTI_V7 is not set
CONFIG_ARCH_SUNXI=y
CONFIG_AEABI=y
CONFIG_CPU_FREQ=y
CONFIG_CPUFREQ_DT=y
CONFIG_CPU_IDLE=y
CONFIG_ARM_CPUIDLE=y
# CONFIG_SUSPEND is not set
CONFIG_JUMP_LABEL=y
CONFIG_STRICT_KERNEL_RWX=y
# CONFIG_BLK_DEBUG_FS is not set
# CONFIG_MQ_IOSCHED_DEADLINE is not set
# CONFIG_MQ_IOSCHED_KYBER is not set
CONFIG_UEVENT_HELPER=y
CONFIG_DEVTMPFS=y
CONFIG_DEVTMPFS_MOUNT=y
CONFIG_SUNXI_RSB=y
CONFIG_MTD=y
CONFIG_MTD_M25P80=y
CONFIG_MTD_SPI_NOR=y
CONFIG_MTD_UBI=y
CONFIG_MTD_UBI_BLOCK=y
CONFIG_INPUT_POLLDEV=y
CONFIG_INPUT_EVDEV=y
# CONFIG_KEYBOARD_ATKBD is not set
CONFIG_KEYBOARD_SUN4I_LRADC=y
# CONFIG_INPUT_MOUSE is not set
# CONFIG_SERIO_SERPORT is not set
CONFIG_VT_HW_CONSOLE_BINDING=y
CONFIG_SERIAL_8250=y
CONFIG_SERIAL_8250_CONSOLE=y
CONFIG_SERIAL_8250_NR_UARTS=8
CONFIG_SERIAL_8250_RUNTIME_UARTS=8
CONFIG_SERIAL_8250_DW=y
CONFIG_SERIAL_OF_PLATFORM=y
# CONFIG_HW_RANDOM is not set
CONFIG_SPI=y
CONFIG_SPI_GPIO=y
CONFIG_SPI_SUN6I=y
CONFIG_SPI_SPIDEV=y
CONFIG_GPIO_SYSFS=y
CONFIG_POWER_SUPPLY=y
# CONFIG_HWMON is not set
CONFIG_THERMAL=y
CONFIG_CPU_THERMAL=y
CONFIG_MFD_AXP20X_RSB=y
CONFIG_MFD_SYSCON=y
CONFIG_REGULATOR=y
CONFIG_REGULATOR_FIXED_VOLTAGE=y
# CONFIG_HID is not set
# CONFIG_USB_HID is not set
CONFIG_USB=y
CONFIG_USB_DYNAMIC_MINORS=y
CONFIG_USB_EHCI_HCD=y
# CONFIG_USB_EHCI_TT_NEWSCHED is not set
CONFIG_USB_EHCI_HCD_PLATFORM=y
CONFIG_USB_OHCI_HCD=y
CONFIG_USB_OHCI_HCD_PLATFORM=y
CONFIG_USB_MUSB_HDRC=y
CONFIG_USB_MUSB_SUNXI=y
CONFIG_NOP_USB_XCEIV=y
CONFIG_USB_GADGET=y
CONFIG_USB_GADGET_VBUS_DRAW=500
CONFIG_USB_G_ACM_MS=y
CONFIG_MMC=y
CONFIG_MMC_SUNXI=y
CONFIG_NEW_LEDS=y
CONFIG_LEDS_CLASS=y
CONFIG_LEDS_GPIO=y
CONFIG_LEDS_TRIGGERS=y
CONFIG_LEDS_TRIGGER_HEARTBEAT=y
CONFIG_LEDS_TRIGGER_DEFAULT_ON=y
CONFIG_SYNC_FILE=y
# CONFIG_VIRTIO_MENU is not set
CONFIG_SUN8I_A83T_CCU=y
CONFIG_SUN8I_DE2_CCU=y
CONFIG_SUN8I_R_CCU=y
# CONFIG_IOMMU_SUPPORT is not set
CONFIG_PHY_SUN4I_USB=y
# CONFIG_NVMEM is not set
CONFIG_EXT4_FS=y
# CONFIG_FILE_LOCKING is not set
# CONFIG_DNOTIFY is not set
CONFIG_VFAT_FS=y
CONFIG_TMPFS=y
CONFIG_SQUASHFS=y
CONFIG_SQUASHFS_FILE_DIRECT=y
# CONFIG_SQUASHFS_ZLIB is not set
CONFIG_SQUASHFS_XZ=y
CONFIG_NLS_CODEPAGE_437=y
CONFIG_NLS_ISO8859_1=y
CONFIG_KEYS=y
# CONFIG_CRYPTO_ECHAINIV is not set
# CONFIG_CRYPTO_HW is not set
CONFIG_PRINTK_TIME=y
CONFIG_DEBUG_FS=y
CONFIG_STACKTRACE=y
CONFIG_RCU_TRACE=y
# CONFIG_FTRACE is not set
```

## board/businesscard/v1/uboot_defconfig
```kconfig
CONFIG_ARM=y
CONFIG_ARCH_SUNXI=y
CONFIG_SYS_TEXT_BASE=0x81700000
CONFIG_ENV_SIZE=0x8000
CONFIG_SPL=y
CONFIG_MACH_SUNIV=y
CONFIG_DRAM_CLK=156
CONFIG_DRAM_ZQ=0
# CONFIG_VIDEO_SUNXI is not set
CONFIG_SPL_SPI_SUNXI=y
# CONFIG_FIT is not set
CONFIG_BOOTDELAY=0
CONFIG_BOOTCOMMAND="setenv bootargs console=ttyS0,115200 ubi.mtd=1 ubi.block=0,root ubi.block=0,flashdrive root=/dev/ubiblock0_2 g_acm_ms.removable=1; sf probe 0 20000000; ubi part rootubi; ubi read ${kernel_addr_r} kernel; ubi read ${fdt_addr_r} dtb; bootz ${kernel_addr_r} - ${fdt_addr_r}"
CONFIG_LOG_MAX_LEVEL=6
CONFIG_LOG_ERROR_RETURN=y
# CONFIG_SYS_MMCSD_RAW_MODE_U_BOOT_USE_SECTOR is not set
CONFIG_SPL_MTD_SUPPORT=y
# CONFIG_SPL_POWER_SUPPORT is not set
CONFIG_SPL_RAM_SUPPORT=y
CONFIG_SPL_RAM_DEVICE=y
# CONFIG_CMD_FLASH is not set
# CONFIG_CMD_GPT is not set
# CONFIG_CMD_LOADB is not set
# CONFIG_CMD_PINMUX is not set
CONFIG_CMD_SF=y
CONFIG_CMD_USB_SDP=y
CONFIG_CMD_USB_MASS_STORAGE=y
CONFIG_MTDIDS_DEFAULT="nor0=spi-flash"
CONFIG_MTDPARTS_DEFAULT="mtdparts=spi-flash:512k(uboot),-(rootubi)"
CONFIG_CMD_LOG=y
CONFIG_CMD_UBI=y
# CONFIG_CMD_UBIFS is not set
# CONFIG_SPL_DOS_PARTITION is not set
# CONFIG_ISO_PARTITION is not set
# CONFIG_SPL_EFI_PARTITION is not set
CONFIG_DEFAULT_DEVICE_TREE="businesscard"
# CONFIG_ENV_IS_IN_FAT is not set
# CONFIG_NET is not set
# CONFIG_USB_FUNCTION_FASTBOOT is not set
# CONFIG_MMC_HW_PARTITIONING is not set
CONFIG_MTD=y
CONFIG_DM_SPI_FLASH=y
CONFIG_SPI_FLASH=y
CONFIG_SF_DEFAULT_MODE=0x0
CONFIG_SF_DEFAULT_SPEED=20000000
CONFIG_SPI_FLASH_ATMEL=y
CONFIG_SPI_FLASH_GIGADEVICE=y
CONFIG_SPI_FLASH_MACRONIX=y
CONFIG_SPI_FLASH_WINBOND=y
# CONFIG_SPI_FLASH_USE_4K_SECTORS is not set
CONFIG_SPI_FLASH_MTD=y
CONFIG_PHY_SUN4I_USB=y
CONFIG_PINCTRL=y
CONFIG_SPI=y
CONFIG_DM_SPI=y
CONFIG_SPI_SUNXI=y
CONFIG_USB_MUSB_GADGET=y
CONFIG_USB_GADGET_DOWNLOAD=y
CONFIG_SYS_WHITE_ON_BLACK=y
CONFIG_SHA1=y
CONFIG_SHA256=y
CONFIG_EFI_LOADER_HII=y
```

## configs/thirtythreeforty_businesscard_defconfig
```kconfig
BR2_arm=y
BR2_ARM_INSTRUCTIONS_THUMB=y
BR2_SVN="svn"
BR2_CCACHE=y
BR2_SHARED_STATIC_LIBS=y
BR2_GLOBAL_PATCH_DIR="$(BR2_EXTERNAL_BUSINESSCARD_PATH)/patches"
BR2_KERNEL_HEADERS_5_1=y
BR2_TOOLCHAIN_BUILDROOT_WCHAR=y
# BR2_UCLIBC_INSTALL_UTILS is not set
BR2_GCC_VERSION_8_X=y
BR2_TOOLCHAIN_BUILDROOT_CXX=y
BR2_TARGET_GENERIC_HOSTNAME="linuxcard"
BR2_TARGET_GENERIC_ISSUE="Welcome to Businesscard Linux!"
BR2_TARGET_GENERIC_GETTY_PORT="/dev/ttyS0"
BR2_TARGET_GENERIC_GETTY_BAUDRATE_115200=y
# BR2_TARGET_GENERIC_REMOUNT_ROOTFS_RW is not set
BR2_ROOTFS_OVERLAY="$(BR2_EXTERNAL_BUSINESSCARD_PATH)/board/businesscard/rootfs_overlay"
BR2_ROOTFS_POST_BUILD_SCRIPT="$(BR2_EXTERNAL_BUSINESSCARD_PATH)/board/businesscard/v1/post-build.sh"
BR2_ROOTFS_POST_IMAGE_SCRIPT="support/scripts/genimage.sh"
BR2_ROOTFS_POST_SCRIPT_ARGS="-c $(BR2_EXTERNAL_BUSINESSCARD_PATH)/board/businesscard/v1/genimage.cfg"
BR2_LINUX_KERNEL=y
BR2_LINUX_KERNEL_CUSTOM_GIT=y
BR2_LINUX_KERNEL_CUSTOM_REPO_URL="git://github.com/thirtythreeforty/linux.git"
BR2_LINUX_KERNEL_CUSTOM_REPO_VERSION="0258e33350a156ae82c2fe49f58ea63b6fc459e6"
BR2_LINUX_KERNEL_USE_CUSTOM_CONFIG=y
BR2_LINUX_KERNEL_CUSTOM_CONFIG_FILE="$(BR2_EXTERNAL_BUSINESSCARD_PATH)/board/businesscard/v1/linux_defconfig"
BR2_LINUX_KERNEL_DTS_SUPPORT=y
BR2_LINUX_KERNEL_CUSTOM_DTS_PATH="$(BR2_EXTERNAL_BUSINESSCARD_PATH)/board/businesscard/v1/dts/businesscard.dts"
BR2_PACKAGE_DHRYSTONE=y
BR2_PACKAGE_STRESS=y
BR2_PACKAGE_MTD=y
# BR2_PACKAGE_MTD_FLASHCP is not set
# BR2_PACKAGE_MTD_FLASH_ERASE is not set
# BR2_PACKAGE_MTD_FLASH_LOCK is not set
# BR2_PACKAGE_MTD_FLASH_UNLOCK is not set
# BR2_PACKAGE_MTD_MTD_DEBUG is not set
# BR2_PACKAGE_MTD_NANDDUMP is not set
# BR2_PACKAGE_MTD_NANDTEST is not set
# BR2_PACKAGE_MTD_NANDWRITE is not set
BR2_PACKAGE_MICROPYTHON=y
BR2_PACKAGE_MICROPYTHON_LIB=y
BR2_PACKAGE_LIBTIRPC=y
# BR2_PACKAGE_IFUPDOWN_SCRIPTS is not set
BR2_TARGET_ROOTFS_SQUASHFS=y
BR2_TARGET_ROOTFS_SQUASHFS4_XZ=y
# BR2_TARGET_ROOTFS_TAR is not set
BR2_TARGET_UBOOT=y
BR2_TARGET_UBOOT_BUILD_SYSTEM_KCONFIG=y
BR2_TARGET_UBOOT_CUSTOM_GIT=y
BR2_TARGET_UBOOT_CUSTOM_REPO_URL="git://github.com/thirtythreeforty/u-boot.git"
BR2_TARGET_UBOOT_CUSTOM_REPO_VERSION="e9a861c19c620224f5c1224cd7033b02adb8fa4d"
BR2_TARGET_UBOOT_USE_CUSTOM_CONFIG=y
BR2_TARGET_UBOOT_CUSTOM_CONFIG_FILE="$(BR2_EXTERNAL_BUSINESSCARD_PATH)/board/businesscard/v1/uboot_defconfig"
BR2_TARGET_UBOOT_NEEDS_DTC=y
BR2_TARGET_UBOOT_NEEDS_PYLIBFDT=y
# BR2_TARGET_UBOOT_FORMAT_BIN is not set
BR2_TARGET_UBOOT_FORMAT_CUSTOM=y
BR2_TARGET_UBOOT_FORMAT_CUSTOM_NAME="u-boot-sunxi-with-spl.bin"
BR2_TARGET_UBOOT_CUSTOM_DTS_PATH="$(BR2_EXTERNAL_BUSINESSCARD_PATH)/board/businesscard/v1/dts/*"
BR2_PACKAGE_HOST_MKPASSWD=y
BR2_PACKAGE_HOST_MTD=y
BR2_PACKAGE_HOST_SUNXI_TOOLS_F1C100S=y
BR2_PACKAGE_BUSINESSCARD_FLASHDRIVE=y
BR2_PACKAGE_2048=y
BR2_PACKAGE_FORTUNE_MOD=y
BR2_PACKAGE_FORTUNE_MOD_COOKIES="computers;humorists;linuxcookie;literature;pratchett;startrek;wisdom"
BR2_PACKAGE_ROBOTFINDSKITTEN=y
BR2_PACKAGE_ROGUE=y
```

## package/2048/Config.in
```kconfig
config BR2_PACKAGE_2048
	bool "2048"
	select BR2_PACKAGE_NCURSES
	help
	  Console version of the game "2048" for GNU/Linux

	  https://github.com/mevdschee/2048.c
```

## package/businesscard-flashdrive/Config.in
```kconfig
config BR2_PACKAGE_BUSINESSCARD_FLASHDRIVE
	bool "businesscard-flashdrive"
	select BR2_PACKAGE_HOST_GENIMAGE
	select BR2_PACKAGE_HOST_DOSFSTOOLS
	select BR2_PACKAGE_HOST_MTOOLS
	help
	  The "flash drive" image that appears when you plug my business card into
	  a PC.

	  https://github.com/thirtythreeforty
```

## package/fortune-mod/Config.in
```kconfig
config BR2_PACKAGE_FORTUNE_MOD
	bool "fortune-mod"
	select BR2_PACKAGE_LIBRECODE
	help
	  The Fortune Cookie Program from BSD games

	  https://www.shlomifish.org/open-source/projects/fortune-mod/

if BR2_PACKAGE_FORTUNE_MOD

config BR2_PACKAGE_FORTUNE_MOD_COOKIES
	string "fortune cookie files"
	help
	  Specify which fortunes to include in a semicolon-separated list.
	  If empty, include them all.

config BR2_PACKAGE_FORTUNE_MOD_OFFENSIVE
	bool "offensive cookies"
	help
	  Enable potentially-offensive cookies.

if BR2_PACKAGE_FORTUNE_MOD_OFFENSIVE

config BR2_PACKAGE_FORTUNE_MOD_OCOOKIES
	string "offensive fortune cookie files"
	help
	  Specify which offensive fortunes to include in a semicolon-separated
	  list.  If empty, include them all.

endif

endif
```

## package/librecode/Config.in
```kconfig
config BR2_PACKAGE_LIBRECODE
	bool "librecode"
	depends on BR2_USE_WCHAR
	select BR2_PACKAGE_LIBICONV
	help
	  Converts files between various character sets and usages

	  https://github.com/rrthomas/recode
```

## package/robotfindskitten/Config.in
```kconfig
config BR2_PACKAGE_ROBOTFINDSKITTEN
	bool "robotfindskitten"
	select BR2_PACKAGE_NCURSES
	help
	  A Zen simulation.

	  http://robotfindskitten.org/
```

## package/rogue/Config.in
```kconfig
config BR2_PACKAGE_ROGUE
	bool "rogue"
	select BR2_PACKAGE_NCURSES
	help
	  The original dungeon crawl game

	  http://www.roguebasin.com/index.php?title=Rogue
```

## package/sunxi-tools-f1c100s/Config.in
```kconfig
config BR2_PACKAGE_SUNXI_TOOLS_F1C100S
	bool "sunxi-tools for F1C100s"
	depends on BR2_arm
	help
	  Tools for Allwinner A10 (aka sun4i) and A13 (aka sun5i)
	  and suniv based devices.

	  http://linux-sunxi.org/Sunxi-tools

if BR2_PACKAGE_SUNXI_TOOLS_F1C100S

config BR2_PACKAGE_SUNXI_TOOLS_F1C100S_FEXC
	bool "sunxi-fexc (fex2bin & bin2fex)"
	help
	  Convert between .fex board definition files and binary
	  format. These tools are specific for the linux-sunxi kernel
	  and do not apply to the mainline Linux kernel version.

config BR2_PACKAGE_SUNXI_TOOLS_F1C100S_BOOTINFO
	bool "sunxi-bootinfo"
	help
	  Displays information about sunxi boot code.

config BR2_PACKAGE_SUNXI_TOOLS_F1C100S_FEL
	bool "sunxi-fel"
	depends on BR2_TOOLCHAIN_HAS_THREADS # libusb
	select BR2_PACKAGE_LIBUSB
	help
	  The sunxi-fel command can interact with a sunxi device in
	  fel mode. This allows do download code to memory and execute
	  it.

comment "sunxi-fel needs a toolchain w/ threads"
	depends on !BR2_TOOLCHAIN_HAS_THREADS

config BR2_PACKAGE_SUNXI_TOOLS_F1C100S_NAND_PART
	bool "sunxi-nand-part"
	default y
	help
	  The sunxi-nand-part command allows to repartition the internal
	  NAND on sunxi devices.

config BR2_PACKAGE_SUNXI_TOOLS_F1C100S_PIO
	bool "sunxi-pio"
	help
	  GPIO manipulation tool for sunxi boards.

config BR2_PACKAGE_SUNXI_TOOLS_F1C100S_MEMINFO
	bool "sunxi-meminfo"
	help
	  Utility to retrieve DRAM information from registers on
	  Allwinner SoCs. Specific for the linux-sunxi kernel - does
	  not apply to the mainline Linux kernel version.

config BR2_PACKAGE_SUNXI_TOOLS_F1C100S_PHOENIX_INFO
	bool "phoenix_info"
	help
	  Display information about self-installing SD card images
	  (created with Phoenix Card).

	  https://linux-sunxi.org/PhoenixCard

config BR2_PACKAGE_SUNXI_TOOLS_F1C100S_NAND_IMAGE_BUILDER
	bool "sunxi-nand-image-builder"
	help
	  Creates a raw NAND image that can be read by the sunxi NAND
	  controller.

endif # BR2_PACKAGE_SUNXI_TOOLS_F1C100S
```
